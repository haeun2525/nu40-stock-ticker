/*
  NU40 DK Real-Time Stock Ticker — Board Firmware
  ------------------------------------------------------------------
  This board does exactly two things.
    1) Receives "already-computed numbers" sent over USB by the PC (Python bridge.py) and draws them on the OLED.
    2) Uses 4 buttons to change the stock shown, and lights an alert LED at the threshold.

  This board (nRF52840) has no WiFi. So the PC does all the internet calls, JSON parsing and
  chart calculation, and the board only "draws what it receives". Do not change this division of roles.

  Terms in one line
    - I2C   : A communication method that uses 2 wires (SDA/SCL) to talk to parts like the display.
    - Serial : A channel for exchanging characters with the PC over the USB cable. Uses 115200 speed here.
    - Slot   : The place one stock occupies. Slots 0~3 correspond to buttons 1~4.
*/

#include <Wire.h>
#include <Adafruit_GFX.h>
#include <Adafruit_SSD1306.h>

// Korean font data. Generated by tools/make_hangul_font.py.
#include "hangul_font.h"

// ─────────────────────────────────────────────────────────────
// Hardware settings (values confirmed from the schematic - do not change)
// ─────────────────────────────────────────────────────────────

// The OLED is connected to P0.26 (SDA) / P0.27 (SCL).
// The NU40DK board package's variant.h already sets PIN_WIRE_SDA=26, PIN_WIRE_SCL=27,
// so the Wire.begin() default is exactly P0.26/P0.27.
// So on this board there is no need to call Wire.setPins() separately.
static const uint8_t PIN_OLED_SDA = PIN_WIRE_SDA;  // = 26 (P0.26)
static const uint8_t PIN_OLED_SCL = PIN_WIRE_SCL;  // = 27 (P0.27)

// 4 built-in buttons. LOW(0) when pressed, so read with INPUT_PULLUP.
static const uint8_t BUTTON_PINS[4] = { 11, 12, 24, 25 };  // P0.11 / P0.12 / P0.24 / P0.25

// 4 built-in LEDs. Driving HIGH turns them on (LED_STATE_ON = 1 in variant.h).
static const uint8_t LED_PINS[4]    = { 13, 14, 15, 16 };  // P0.13 / P0.14 / P0.15 / P0.16

// Display: SSD1306, 128x64, I2C.
static const uint8_t OLED_ADDR_MAIN = 0x3C;  // default address
static const uint8_t OLED_ADDR_ALT  = 0x3D;  // address to try when the default is not found

#define SCREEN_WIDTH  128
#define SCREEN_HEIGHT 64
#define OLED_RESET    -1   // means the NU40DK has no dedicated screen reset pin

Adafruit_SSD1306 display(SCREEN_WIDTH, SCREEN_HEIGHT, &Wire, OLED_RESET);

// ─────────────────────────────────────────────────────────────
// Screen layout (128 x 64 pixels)
//   y  0~11 : stock name (left) / change rate (right-aligned)
//   y 12~27 : current price, large text (size 2)
//   y 28~57 : mini chart
//   y 58~63 : slot indicator (only the slot being viewed is fully filled)
// ─────────────────────────────────────────────────────────────
static const int16_t HEADER_Y      = 1;    // top row of the stock name (Korean, 9 pixels)
static const int16_t CHG_Y         = 2;    // top row of the change rate. The English font is 2 pixels smaller, so it is shifted down to match.
static const int16_t PRICE_Y       = 13;   // top row of the current price text
static const int16_t CHART_TOP     = 31;   // top of the chart area
static const int16_t CHART_BOTTOM  = 57;   // bottom of the chart area
static const int16_t CHART_HEIGHT  = CHART_BOTTOM - CHART_TOP;  // = 26 pixels
static const int16_t INDICATOR_Y   = 58;   // top row of the slot indicator

// ─────────────────────────────────────────────────────────────
// Slot data
// ─────────────────────────────────────────────────────────────
static const uint8_t SLOT_COUNT   = 4;
static const uint8_t CHART_POINTS = 64;   // number of chart points (the PC sends 64)
static const uint8_t CHART_MAX    = 36;   // max chart value. The PC normalizes to integers 0~36 before sending.

struct Slot {
  char    name[32];               // short name to show on screen.
                                  // Korean takes 3 bytes per character (UTF-8), so allow plenty of room.
  char    price[16];              // current price string (e.g. "68,900")
  char    chg[12];                // change-rate string (e.g. "-2.96%")
  uint8_t alert;                  // if 1, price is below threshold -> LED on
  uint8_t chart[CHART_POINTS];    // chart values 0~36
  bool    hasData;                // whether a value has ever been received from the PC
};

static Slot    slots[SLOT_COUNT];
static uint8_t currentSlot = 0;   // slot currently being drawn on screen
static bool    needsRedraw  = true;  // whether the screen must be redrawn (true only when values change)
static bool    displayOk    = false; // whether the OLED was found successfully

// ─────────────────────────────────────────────────────────────
// Serial receive buffer
// One line from the PC is at most about 230 characters. Allow a generous 320.
// ─────────────────────────────────────────────────────────────
static const uint16_t LINE_BUF_SIZE = 320;
static char     lineBuf[LINE_BUF_SIZE];
static uint16_t lineLen      = 0;
static bool     lineOverflow = false;  // whether a line was too long and got truncated

// ─────────────────────────────────────────────────────────────
// Button debounce
// A button bounces electrically a few times at the moment of pressing. Changes within 30ms are ignored.
// ─────────────────────────────────────────────────────────────
static const uint32_t DEBOUNCE_MS = 30;
static bool     buttonWasDown[4]   = { false, false, false, false };
static uint32_t buttonChangedAt[4] = { 0, 0, 0, 0 };

static uint32_t lastErrorNoticeMs = 0;  // used to send the OLED error message only once every 5 seconds

// ─────────────────────────────────────────────────────────────
// Setup
// ─────────────────────────────────────────────────────────────
void setup() {
  Serial.begin(115200);

  // Buttons: LOW when pressed. Enable the internal pull-up so they read HIGH normally.
  for (uint8_t i = 0; i < SLOT_COUNT; i++) {
    pinMode(BUTTON_PINS[i], INPUT_PULLUP);
  }

  // LEDs: all off at first.
  for (uint8_t i = 0; i < SLOT_COUNT; i++) {
    pinMode(LED_PINS[i], OUTPUT);
    digitalWrite(LED_PINS[i], LOW);
  }

  // Initialize the slots to empty.
  for (uint8_t i = 0; i < SLOT_COUNT; i++) {
    slots[i].name[0]  = '\0';
    slots[i].price[0] = '\0';
    slots[i].chg[0]   = '\0';
    slots[i].alert    = 0;
    slots[i].hasData  = false;
    for (uint8_t j = 0; j < CHART_POINTS; j++) slots[i].chart[j] = 0;
  }

  // Start I2C. The NU40DK default is already P0.26/P0.27, so no pin assignment is needed.
  Wire.begin();
  Wire.setClock(400000);  // raise to 400kHz to refresh the screen quickly

  // Look for the OLED at address 0x3C, and if absent try 0x3D once more.
  displayOk = display.begin(SSD1306_SWITCHCAPVCC, OLED_ADDR_MAIN);
  if (!displayOk) {
    displayOk = display.begin(SSD1306_SWITCHCAPVCC, OLED_ADDR_ALT);
  }

  if (displayOk) {
    display.clearDisplay();
    display.setTextColor(SSD1306_WHITE);
    drawScreen();
  }

  // Tell the PC "I'm ready". On seeing this line the PC immediately sends all 4 slots.
  Serial.println("READY");

  if (!displayOk) {
    Serial.println("ERR|OLED not found. Check wiring: SDA=P0.26, SCL=P0.27, VCC=VMOD (3.3V), GND.");
  }
}

// ─────────────────────────────────────────────────────────────
// Loop
// ─────────────────────────────────────────────────────────────
void loop() {
  readSerial();
  readButtons();

  // Redraw the screen only when values have actually changed.
  // Drawing every time visibly flickers.
  if (needsRedraw && displayOk) {
    drawScreen();
    needsRedraw = false;
  }

  // If there is no OLED, report only once every 5 seconds (so the log is not flooded).
  if (!displayOk && millis() - lastErrorNoticeMs > 5000) {
    lastErrorNoticeMs = millis();
    Serial.println("ERR|No OLED. Check the wiring, then reconnect the board.");
  }
}

// ─────────────────────────────────────────────────────────────
// Collect the characters sent by the PC one line at a time
// ─────────────────────────────────────────────────────────────
void readSerial() {
  while (Serial.available() > 0) {
    char c = (char)Serial.read();

    if (c == '\r') continue;  // discard the leading character of a Windows line ending

    if (c == '\n') {
      lineBuf[lineLen] = '\0';
      if (lineOverflow) {
        Serial.println("ERR|Line too long. Ignored.");
      } else if (lineLen > 0) {
        handleLine(lineBuf);
      }
      lineLen      = 0;
      lineOverflow = false;
      continue;
    }

    if (lineLen < LINE_BUF_SIZE - 1) {
      lineBuf[lineLen++] = c;
    } else {
      lineOverflow = true;  // on overflow, discard this whole line
    }
  }
}

// ─────────────────────────────────────────────────────────────
// Parse one line
//   D|<slot>|<name>|<price>|<chg>|<alert>|<v0>,<v1>,...,<v63>
// ─────────────────────────────────────────────────────────────
void handleLine(char* line) {
  if (line[0] != 'D' || line[1] != '|') {
    Serial.println("ERR|Unknown command. Lines must start with D|");
    return;
  }

  // Split into 6 fields on '|'. The last field (chart) is left whole, not split.
  char*   field[6];
  uint8_t fieldCount = 0;
  char*   cursor     = line + 2;

  field[fieldCount++] = cursor;
  while (*cursor != '\0' && fieldCount < 6) {
    if (*cursor == '|') {
      *cursor = '\0';               // cut here, and
      field[fieldCount++] = cursor + 1;  // remember the start of the next field
    }
    cursor++;
  }

  if (fieldCount < 6) {
    Serial.println("ERR|Not enough fields. Expected D|slot|name|price|chg|alert|chart");
    return;
  }

  // 1) Slot number
  long slotNo = atol(field[0]);
  if (slotNo < 0 || slotNo >= SLOT_COUNT) {
    Serial.println("ERR|Slot number must be 0-3.");
    return;
  }
  Slot& s = slots[slotNo];

  // 2) Text items. If they exceed the set length, the tail is cut off when stored.
  bool changed = false;
  changed |= copyIfChanged(s.name,  field[1], sizeof(s.name));
  changed |= copyIfChanged(s.price, field[2], sizeof(s.price));
  changed |= copyIfChanged(s.chg,   field[3], sizeof(s.chg));

  // 3) Alert flag (0 or 1)
  uint8_t alert = (field[4][0] == '1') ? 1 : 0;
  if (alert != s.alert) {
    s.alert = alert;
    changed = true;
  }

  // 4) 64 chart values. Integers 0~36 separated by commas.
  uint8_t count  = 0;
  char*   p      = field[5];
  while (*p != '\0' && count < CHART_POINTS) {
    long v = atol(p);                 // read one number, and
    if (v < 0) v = 0;                 // clamp it if out of range
    if (v > CHART_MAX) v = CHART_MAX;
    if (s.chart[count] != (uint8_t)v) {
      s.chart[count] = (uint8_t)v;
      changed = true;
    }
    count++;
    while (*p != '\0' && *p != ',') p++;  // skip ahead to the next comma, and
    if (*p == ',') p++;                    // step past the comma
  }

  if (count < CHART_POINTS) {
    Serial.println("ERR|Fewer than 64 chart values. Drawing what was received.");
    // Fill the missing tail with 0.
    while (count < CHART_POINTS) {
      if (s.chart[count] != 0) { s.chart[count] = 0; changed = true; }
      count++;
    }
  }

  if (!s.hasData) {
    s.hasData = true;
    changed   = true;
  }

  // The LED lights even if this is not the slot being viewed.
  // Because we need to know when another stock has dropped below its threshold too. Always on, no blinking.
  digitalWrite(LED_PINS[slotNo], s.alert ? HIGH : LOW);

  // Redraw only when the value of the slot being viewed has actually changed.
  if (slotNo == currentSlot && changed) {
    needsRedraw = true;
  }
}

// If the new text differs from the existing, copy it and return true (= the screen must be redrawn).
bool copyIfChanged(char* dst, const char* src, size_t dstSize) {
  if (strncmp(dst, src, dstSize - 1) == 0) return false;
  strncpy(dst, src, dstSize - 1);
  dst[dstSize - 1] = '\0';
  return true;
}

// ─────────────────────────────────────────────────────────────
// Reading buttons
// Pressing a button switches the screen immediately with cached values, without waiting for the PC's response.
// ─────────────────────────────────────────────────────────────
void readButtons() {
  uint32_t now = millis();

  for (uint8_t i = 0; i < SLOT_COUNT; i++) {
    bool isDown = (digitalRead(BUTTON_PINS[i]) == LOW);  // LOW when pressed

    if (isDown != buttonWasDown[i]) {
      if (now - buttonChangedAt[i] < DEBOUNCE_MS) continue;  // ignore bounce
      buttonChangedAt[i] = now;
      buttonWasDown[i]   = isDown;

      if (isDown && currentSlot != i) {   // react only at the moment of a new press
        currentSlot = i;
        needsRedraw = true;              // switch immediately using cached values
        Serial.print("SEL|");
        Serial.println(i);
      }
    }
  }
}

// ─────────────────────────────────────────────────────────────
// Drawing Korean
//
// The Arduino default font has no Korean, so the glyph shapes are embedded directly as bitmaps.
// (hangul_font.h - Galmuri9 pixel font, 9x9 pixels, 10-pixel character spacing)
// English and digits use the default font as-is, and only Korean is drawn with this bitmap.
// ─────────────────────────────────────────────────────────────

// Reads one character from UTF-8 text and converts it to a Unicode code point.
// Returns how many bytes were read in used.
// (In UTF-8 a character is 1~3 bytes. English is 1 byte, Korean is 3 bytes.)
uint32_t utf8Next(const char* s, uint8_t* used) {
  uint8_t c = (uint8_t)s[0];
  if (c < 0x80) {                       // English/digits
    *used = 1;
    return c;
  }
  if ((c & 0xE0) == 0xC0) {             // 2-byte character
    *used = 2;
    return ((uint32_t)(c & 0x1F) << 6) | (s[1] & 0x3F);
  }
  if ((c & 0xF0) == 0xE0) {             // 3-byte character (Korean falls here)
    *used = 3;
    return ((uint32_t)(c & 0x0F) << 12) | ((uint32_t)(s[1] & 0x3F) << 6) | (s[2] & 0x3F);
  }
  *used = 1;                            // skip one byte for an unhandleable character
  return 0;
}

// Finds which entry in the font list a character code is. Returns -1 if absent.
// The list is sorted from the smallest code, so it halves the range each step (binary search). 2350 characters are found within 12 steps.
int16_t hangulIndex(uint32_t code) {
  if (code < 0xAC00 || code > 0xD7A3) return -1;   // not in the Hangul syllable range

  int16_t low = 0;
  int16_t high = HANGUL_COUNT - 1;
  while (low <= high) {
    int16_t mid = (low + high) / 2;
    uint16_t here = HANGUL_CODES[mid];
    if (here == code) return mid;
    if (here < code) low = mid + 1;
    else             high = mid - 1;
  }
  return -1;
}

// Draws one Korean character. (x, y) is the top left of the character.
void drawHangulGlyph(int16_t x, int16_t y, int16_t index) {
  const uint8_t* glyph = HANGUL_BITS[index];
  for (uint8_t row = 0; row < HANGUL_H; row++) {
    uint8_t left = glyph[row * 2];        // left 8 columns
    uint8_t last = glyph[row * 2 + 1];    // the 9th column is the top bit of this byte
    for (uint8_t col = 0; col < 8; col++) {
      if (left & (0x80 >> col)) display.drawPixel(x + col, y + row, SSD1306_WHITE);
    }
    if (last & 0x80) display.drawPixel(x + 8, y + row, SSD1306_WHITE);
  }
}

// Draws text mixing Korean and English. y is the top row of the characters.
void drawMixedText(int16_t x, int16_t y, const char* text) {
  display.setTextSize(1);
  while (*text != '\0') {
    uint8_t used;
    uint32_t code = utf8Next(text, &used);
    int16_t index = hangulIndex(code);

    if (index >= 0) {
      drawHangulGlyph(x, y, index);
      x += HANGUL_ADVANCE;
    } else if (code >= 0x20 && code < 0x80) {
      // English/digits use the default font (5x7). It is 2 pixels smaller than Korean, so shift down 1 pixel to align eye level.
      display.drawChar(x, y + 1, (char)code, SSD1306_WHITE, SSD1306_BLACK, 1);
      x += 6;
    }
    text += used;
  }
}

// Measures in advance how many horizontal pixels it takes when drawn. Used for right alignment.
int16_t measureMixedText(const char* text) {
  int16_t width = 0;
  while (*text != '\0') {
    uint8_t used;
    uint32_t code = utf8Next(text, &used);
    if (hangulIndex(code) >= 0)            width += HANGUL_ADVANCE;
    else if (code >= 0x20 && code < 0x80)  width += 6;
    text += used;
  }
  return width;
}

// ─────────────────────────────────────────────────────────────
// Drawing the screen
// ─────────────────────────────────────────────────────────────
void drawScreen() {
  Slot& s = slots[currentSlot];

  display.clearDisplay();

  if (!s.hasData) {
    // A slot that has not yet received values from the PC.
    drawMixedText(0, HEADER_Y, "WAITING");
    display.setTextSize(1);
    display.setCursor(0, PRICE_Y + 4);
    display.print("SLOT ");
    display.print(currentSlot + 1);
    drawIndicator();
    display.display();
    return;
  }

  // 1) Stock name (left). Korean and English may be mixed.
  drawMixedText(0, HEADER_Y, s.name);

  // 2) Change rate (right-aligned). It is only digits and symbols, so the default font is clearer.
  int16_t chgWidth = (int16_t)strlen(s.chg) * 6;
  int16_t chgX     = SCREEN_WIDTH - chgWidth;
  if (chgX < 0) chgX = 0;
  display.setTextSize(1);
  display.setCursor(chgX, CHG_Y);
  display.print(s.chg);

  // 3) Current price (large text)
  display.setTextSize(2);
  display.setCursor(0, PRICE_Y);
  display.print(s.price);

  // 4) Chart - connect points with lines rather than plotting every dot.
  drawChart(s.chart);

  // 5) Slot indicator
  drawIndicator();

  display.display();
}

// Chart: place 64 values at x = 0, 2, 4, ..., 126 and connect neighbors with lines.
// Values come in the range 0~36 but the chart area is 30 pixels, so they are scaled down proportionally.
void drawChart(const uint8_t* values) {
  int16_t prevX = 0;
  int16_t prevY = chartValueToY(values[0]);

  for (uint8_t i = 1; i < CHART_POINTS; i++) {
    int16_t x = (int16_t)i * 2;
    int16_t y = chartValueToY(values[i]);
    display.drawLine(prevX, prevY, x, y, SSD1306_WHITE);
    prevX = x;
    prevY = y;
  }
}

// Converts a chart value (0~36) to a vertical screen position. Larger values go higher.
int16_t chartValueToY(uint8_t value) {
  if (value > CHART_MAX) value = CHART_MAX;
  int32_t offset = ((int32_t)value * CHART_HEIGHT) / CHART_MAX;
  return (int16_t)(CHART_BOTTOM - offset);
}

// Slot indicator: 4 squares. Only the slot being viewed is fully filled.
void drawIndicator() {
  const int16_t boxW = 6;
  const int16_t boxH = 5;
  const int16_t gap  = 4;

  for (uint8_t i = 0; i < SLOT_COUNT; i++) {
    int16_t x = (int16_t)i * (boxW + gap);
    if (i == currentSlot) {
      display.fillRect(x, INDICATOR_Y, boxW, boxH, SSD1306_WHITE);
    } else {
      display.drawRect(x, INDICATOR_Y, boxW, boxH, SSD1306_WHITE);
    }
  }
}
